## bsp/stm32/stm32h743-st-cllp/drivers/Kconfig
```kconfig
config RT_USING_UART1
    bool "Using uart1"
    select RT_USING_SERIAL
    default y
config RT_USING_UART3
    bool "Using uart3"
    select RT_USING_SERIAL
    default y
config RT_USING_UART4
    bool "Using uart4"
    select RT_USING_SERIAL
    default y
config RT_USING_EMAC
    bool "Using emac"
    select RT_USING_LWIP
    default n

config RT_USING_GPIO
    bool "Using gpio"
    select RT_USING_PIN
    default n

config RT_USING_ADCONVERT
    bool "Using adc"  
    default n

menu "Extern SDRAM"
    config RT_USING_EXSDRAM
        bool "Using external sdram"
        default n  
    if RT_USING_EXSDRAM
        config EXT_SDRAM_SIZE_MB
            int "external sdram (MB)"
            default 32
    endif
endmenu
```

## bsp/stm32/stm32h743-st-cllp/r_udp/Kconfig
```kconfig
if RT_USING_LWIP
    config RT_USING_RUDP
    bool "Using reliable UDP"
    default n
endif
```
